#include <GUC_dogl128.h>


#if GUC_DOG_CFG_FONT_COMPILE_DEFAULT == 1
code const unsigned char __gucdog_default_font[]=
{//95 5x8 Char
   
   5, //Size in X of a char
   
   32, //Zero(offset)
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   0xEE,0x00,
   0x00
};
xdata unsigned char* __gucdog_font_data=__gucdog_default_font;
#else
xdata unsigned char* __gucdog_font_data;
#endif //GUC_DOG_CFG_FONT_COMPILE_DEFAULT

void GUC_dog_init()
{
   GUC_DOG_CS = 1;
   GUC_DOG_CS = 0;
   #if GUC_DOG_CFG_OUTPUT == GUC_DOG_CFG_OUTPUT_SPISIMULATE
      GUC_DOG_SCLK = 0;
   #endif //GUC_DOG_CFG_OUTPUT_SPISIMULATE
   
   GUC_dog_sendByte(0x40, 0); //Display start line 0
   GUC_dog_sendByte(0xA1, 0); //ADC reverse *)
   GUC_dog_sendByte(0xC0, 0); //Normal COM0~COM63
   GUC_dog_sendByte(0xA6, 0); //Display normal
   GUC_dog_sendByte(0xA2, 0); //Set bias 1/9 (Duty 1/65)
   GUC_dog_sendByte(0x2F, 0); //Booster, Regulator and Follower on
   GUC_dog_sendByte(0xF8, 0); //Set internal Booster to 4x
   GUC_dog_sendByte(0x00, 0); //Set internal Booster to 4x
   GUC_dog_sendByte(0x27, 0); //V0 voltage regulator set
   GUC_dog_sendByte(0x81, 0); //Contrast set
   GUC_dog_sendByte(0x10, 0); //Contrast set
   GUC_dog_sendByte(0xAC, 0); //No indicator
   GUC_dog_sendByte(0x00, 0); //No indicator
   GUC_dog_sendByte(0xAF, 0); //Display on

   GUC_dog_sendByte(0xB0, 0); //Page 0
}

#if GUC_DOG_CFG_OUTPUT == GUC_DOG_CFG_OUTPUT_SPI3WIRE
void GUC_dog_sendByte(const unsigned char _byte, bit _a0)
{
   GUC_DOG_A0 = _a0;

   SPIF = 0;
   SPI0DAT = _byte;
   while (!SPIF);
   SPIF = 0;
}
#endif //GUC_DOG_CFG_OUTPUT_SPI3WIRE

#if GUC_DOG_CFG_OUTPUT == GUC_DOG_CFG_OUTPUT_SPISIMULATE
void GUC_dog_sendByte(const unsigned char _byte, bit _a0)
{
   unsigned char i;

   GUC_DOG_A0 = _a0;

   for (i=0; i<8; ++i)
   {
      GUC_DOG_MOSI = _byte&(0x80>>i);
      GUC_DOG_SCLK = 1;
      GUC_DOG_SCLK = 0;
   }
}
#endif //GUC_DOG_CFG_OUTPUT_SPISIMULATE

void GUC_dog_setCursorPos(const unsigned char _page, const unsigned char _row)
{
   GUC_dog_sendByte(0xB0|(_page&0x0F), 0); //Set page X
   GUC_dog_sendByte(0x00|(_row&0x0F), 0); //Least significant address
   GUC_dog_sendByte(0x10|(_row>>4), 0); //Most significant address
}

void GUC_dog_clearScreen(const unsigned char _value)
{
   unsigned char page, row;

   for (page=0; page<8; ++page)
   {
      GUC_dog_sendByte(0xB0|page, 0); //Set page X
      GUC_dog_sendByte(0x00, 0); //Least significant address
      GUC_dog_sendByte(0x10, 0); //Most significant address
      for (row=0; row<128; ++row)
      {
         GUC_dog_sendByte(_value, 1); //Write
      }
   }
}

void GUC_dog_charWrite(unsigned char _valueChar, const unsigned char _invert)
{//GUC_DOG_CFG_FONT_CUSTOMISABLE_SIZE
   unsigned char x;
   unsigned short addressValue;
   
   _valueChar -= __gucdog_font_data[_GUC_DOG_FONT_ZERO];
   
   if ( _valueChar >= __gucdog_font_data[_GUC_DOG_FONT_SIZE] )
   {
      return;
   }
   
   #if GUC_DOG_CFG_FONT_CUSTOMISABLE_SIZE == 1
   addressValue = _valueChar*__gucdog_font_data[_GUC_DOG_FONT_X] + _GUC_DOG_FONT_HEADER_SIZE;
   #else
   addressValue = _valueChar*_GUC_DOG_FONT_DEFAULT_SIZEX + _GUC_DOG_FONT_HEADER_SIZE;
   #endif //GUC_DOG_CFG_FONT_CUSTOMISABLE_SIZE
   
   
   #if GUC_DOG_CFG_FONT_CUSTOMISABLE_SIZE == 1
   for (x=0; x<__gucdog_font_data[_GUC_DOG_FONT_X]; ++x)
   #else
   for (x=0; x<_GUC_DOG_FONT_DEFAULT_SIZEX; ++x)
   #endif //GUC_DOG_CFG_FONT_CUSTOMISABLE_SIZE
   {
      GUC_dog_sendByte(__gucdog_font_data[addressValue++] ^ _invert, 1); //Write
   }

   GUC_dog_sendByte(_invert, 1); //Write
}

void GUC_dog_stringWrite(const unsigned char* _str, const unsigned char _invert)
{
   while ( *_str )
   {
      GUC_dog_charWrite( *(_str++), _invert);
   }
}
void GUC_dog_pstringWrite(const unsigned char* _str, const unsigned char _invert)
{
   unsigned char i;
   for (i=1; i<_str[0]; ++i)
   {
      GUC_dog_charWrite( _str[i], _invert);
   }
}